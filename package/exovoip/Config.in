## package/exovoip/Config.in
```kconfig
menuconfig BR2_PACKAGE_EXOVOIP
	bool "exovoip"
	default n
	select BR2_PACKAGE_LIBTAPI
	select BR2_PACKAGE_LIBEXOSIP2
	select BR2_PACKAGE_LIBDIALPLAN
	select BR2_PACKAGE_DEUTERON_FRAMEWORK
	select BR2_PACKAGE_JANSSON
	select BR2_PACKAGE_EXOVOIP_SAVER
	select BR2_VOIP_DM_VOIP_VALIDATE_DIGIT_MAP
	select BR2_VOIP_DM_VOIP_PHY_INTERFACE_CALLING_FEATURE
	select BR2_VOIP_DM_VOIP_PHY_INTERFACE_SESSION_CONTROL
	select BR2_VOIP_DM_VOIP_PHY_INTERFACE_VOICE_PROCESSING
	select BR2_VOIP_DM_VOIP_PHY_INTERFACE_BUSY_TONE_TIMEOUT
	select BR2_VOIP_DM_VOIP_PHY_INTERFACE_HOWLER_TONE_TIMEOUT
	select BR2_VOIP_DM_VOIP_PHY_INTERFACE_RULES
	select BR2_VOIP_DM_VOIP_PHY_FLASH_HOOK_TIMES
	select BR2_VOIP_DM_VOIP_VOICE_PROFILE_STUN
	select BR2_VOIP_DM_VOIP_VOICE_PROFILE_V152
	select BR2_VOIP_DM_VOIP_VOICE_PROFILE_NAT_PUBLIC
	select BR2_VOIP_DM_VOIP_VOICE_PROFILE_RPORT
	select BR2_VOIP_DM_VOIP_VOICE_PROFILE_NUMBERING_PLAN
	select BR2_VOIP_DM_VOIP_VOICE_PROFILE_SIP_UA_PORT
	select BR2_VOIP_DM_VOIP_VOICE_PROFILE_SIP_BACKUP
	select BR2_VOIP_DM_VOIP_VOICE_PROFILE_SIP_TRANSPORT
	select BR2_VOIP_DM_VOIP_VOICE_PROFILE_SIP_USER_AGENT
	select BR2_VOIP_DM_VOIP_VOICE_PROFILE_SIP_OUTBOUND
	select BR2_VOIP_DM_VOIP_VOICE_PROFILE_SIP_DSCP
	select BR2_VOIP_DM_VOIP_VOICE_PROFILE_RTP_TELEPHONE_EVENT_PT
	select BR2_VOIP_DM_VOIP_VOICE_PROFILE_RTP_PORTS
	select BR2_VOIP_DM_VOIP_VOICE_PROFILE_RTP_DSCP
	select BR2_VOIP_DM_VOIP_VOICE_PROFILE_LINE_CALL_METHOD
	select BR2_VOIP_DM_VOIP_VOICE_PROFILE_LINE_XDLINK_PHY_REF_LIST
	select BR2_VOIP_DM_VOIP_VOICE_PROFILE_LINE_CODEC
	select BR2_VOIP_DM_VOIP_VOICE_PROFILE_LINE_CALLING_FEATURES
	select BR2_VOIP_DM_VOIP_VOICE_PROFILE_LINE_CALLING_FEATURES_ANSWER_TIME
	select BR2_VOIP_DM_VOIP_VOICE_PROFILE_LINE_CALLING_FEATURES_CALL_FORWARD

	depends on BR2_INSTALL_LIBSTDCPP
	help
	  VoIP daemon

if BR2_PACKAGE_EXOVOIP
config BR2_PACKAGE_EXOVOIP_BRANCH
	string "exovoip package branch"
	default "master"

endif
```

## package/hostapd/Config.in
```kconfig
menuconfig BR2_PACKAGE_HOSTAPD
	bool "hostapd"
	select BR2_PACKAGE_LIBNL
	select BR2_PACKAGE_OPENSSL
	help
	  User space daemon for wireless access points.

	  It implements IEEE 802.11 access point management,
	  IEEE 802.1X/WPA/WPA2/EAP authenticators, RADIUS client,
	  EAP server and RADIUS authentication server.

	  http://w1.fi/hostapd/

if BR2_PACKAGE_HOSTAPD

config BR2_PACKAGE_HOSTAPD_VERSION
	string "git branch"

config BR2_PACKAGE_HOSTAPD_WPS
	bool "Enable WPS"
	help
	  Enable support for Wi-Fi Protected Setup.

config BR2_PACKAGE_HOSTAPD_WPA3
	bool "Enable WPA3 support"
	help
	  Enable WPA3 support

config BR2_PACKAGE_HOSTAPD_WNM
	bool "Enable WNM support"
	default y if BR2_RTW6
	help
	  Enable Wireless Network Management (IEEE Std 802.11v-2011)

config BR2_PACKAGE_HOSTAPD_ACS
	bool "Enable ACS"
	default y
	help
	  Enable support for standard ACS (Automatic Channel Selection).
	  Some propietary drivers use a custom algorithm which requires
	  channel to be set to '0' (which enables ACS in the config),
	  causing hostapd to use the standard one which doesn't work
	  for those cases.

config BR2_PACKAGE_HOSTAPD_VLAN
	bool "Enable VLAN support"
	default y
	help
	  Enable support for VLANs.

if BR2_PACKAGE_HOSTAPD_VLAN

config BR2_PACKAGE_HOSTAPD_VLAN_DYNAMIC
	bool "Enable dynamic VLAN support"
	default y
	help
	  Enable support for fully dynamic VLANs.
	  This enables hostapd to automatically create
	  bridge and VLAN interfaces if necessary.

config BR2_PACKAGE_HOSTAPD_VLAN_NETLINK
	bool "Use netlink-based API for VLAN operations"
	default y
	select BR2_PACKAGE_LIBNL
	help
	  Use netlink-based kernel API for VLAN operations
	  instead of ioctl().

endif # BR2_PACKAGE_HOSTAPD_VLAN

config BR2_PACKAGE_HOSTAPD_DEBUG_SYSLOG
	bool "Enable syslog support"
	help
	  Enable support for sending debug messages to syslog.

endif
```

## package/iw/Config.in
```kconfig
config BR2_PACKAGE_IW
	bool "iw"
	select BR2_PACKAGE_LIBNL_TINY if !BR2_PACKAGE_LIBNL

if BR2_PACKAGE_IW

config BR2_IW_VERSION
	string "iw branch (5.9 if empty)"
	default "3.6" if BR2_ralink
	default "5.9"
	help
		3.6 version
		4.9 version
		5.4 version
		5.9 version

endif
```

## package/libdialplan/Config.in
```kconfig
config BR2_PACKAGE_LIBDIALPLAN
	bool "libdialplan"
	help
		Library for check phone dialing number by dialplan
```

## package/libnl-tiny/Config.in
```kconfig
config BR2_PACKAGE_LIBNL_TINY
	bool "libnl-tiny"
	depends on !BR2_PACKAGE_LIBNL
	help
		This package contains a stripped down version of libnl.
```

## package/libprintf/Config.in
```kconfig
config BR2_PACKAGE_LIBPRINTF
	bool "libprintf"
	default n
	help
	  Userspace library for *printf set of functions.

	  https://github.com/farisey-ru/printf.git
```

## package/libstlport/Config.in
```kconfig
config BR2_PACKAGE_LIBSTLPORT
	bool "libstlport"
	default n
	help
	  STLport is an implementation of the C++ Standard Library, as described in the INTERNATIONAL STANDARD ISO/IEC 14882:1998(E) and latest ISO/IEC 14882:2003(E).
```

## package/net-snmp/Config.in
```kconfig
config BR2_PACKAGE_NET_SNMP
	bool "net-snmp"
	select BR2_PACKAGE_OPENSSL

if BR2_PACKAGE_NET_SNMP

config BR2_PACKAGE_NET_SNMP_SUPPORT_READ_WRITE
	bool "Support rw mibs"

menu "Support net-snmp dlink MIBs"

config BR2_PACKAGE_NET_SNMP_DLINK_DSL_STATISTICS
	bool "Support fetching DSL statistics"
	depends on BR2_SUPPORT_ADSL || BR2_SUPPORT_VDSL
	default y

config BR2_PACKAGE_NET_SNMP_DLINK_BALTCOM_MIBS
	bool "Support Baltcom MIBs"
	default n

endmenu

endif
```

## package/openssl/Config.in
```kconfig
config BR2_PACKAGE_OPENSSL
	bool "openssl"
	select BR2_PACKAGE_ZLIB
	help
	  A collaborative effort to develop a robust, commercial-grade, fully
	  featured, and Open Source toolkit implementing the Secure Sockets
	  Layer (SSL v2/v3) and Transport Security (TLS v1) as well as a
	  full-strength general-purpose cryptography library.

	  http://www.openssl.org/

	  Note: Some helper scripts need perl.

if BR2_PACKAGE_OPENSSL

choice
	prompt "openssl version"

	config BR2_PACKAGE_OPENSSL_VERSION_1_0_2
		bool "1.0.2l"
	config BR2_PACKAGE_OPENSSL_VERSION_1_1_1
		bool "1.1.1i"
endchoice

config BR2_PACKAGE_OPENSSL_VERSION
	string
	default "1.0.2l" if BR2_PACKAGE_OPENSSL_VERSION_1_0_2
	default "1.1.1i" if BR2_PACKAGE_OPENSSL_VERSION_1_1_1

# 4xx PowerPC cores seem to have trouble with openssl's ASM
# optimizations
config BR2_PACKAGE_OPENSSL_TARGET_ARCH_LINUX_PPC
	bool
	default y if BR2_powerpc
	depends on !BR2_powerpc_401
	depends on !BR2_powerpc_403
	depends on !BR2_powerpc_405
	depends on !BR2_powerpc_405fp
	depends on !BR2_powerpc_440
	depends on !BR2_powerpc_440fp

config BR2_PACKAGE_OPENSSL_TARGET_ARCH
	string
	# Use "gcc" minimalistic target to disable DSO
	# no-asm is needed with generic architectures such as gcc, see
	# https://github.com/openssl/openssl/issues/9839
	default "gcc no-asm"			if BR2_STATIC_LIBS
	# Doesn't work for thumb-only (Cortex-M?)
	default "linux-armv4"			if BR2_ARM_CPU_HAS_ARM
	default "linux-bcmarm no-hw --with-rand-seed=devrandom"			if BR2_bcm
	default "linux-aarch64"			if BR2_aarch64
	default "linux-ppc"			if BR2_PACKAGE_OPENSSL_TARGET_ARCH_LINUX_PPC
	default "linux-ppc64"			if BR2_powerpc64
	default "linux-ppc64le"			if BR2_powerpc64le
	default "linux-generic32 386"		if BR2_i386 && BR2_PACKAGE_OPENSSL_VERSION_1_0_2
	default "linux-x86"			if BR2_i386 && BR2_PACKAGE_OPENSSL_VERSION_1_1_1
	default "linux-x86_64"			if BR2_x86_64
	# no-asm is needed with generic architectures such as
	# linux-generic{32,64}, see
	# https://github.com/openssl/openssl/issues/9839
	default "linux-generic64 no-asm"	if BR2_ARCH_IS_64 && !BR2_MIPS_NABI32
	default "linux-generic32 no-asm"

config BR2_PACKAGE_OPENSSL_BIN
	bool "openssl binary"
	help
	  Install the openssl binary and the associated helper scripts
	  to the target file system. This is a command line tool for
	  doing various cryptographic stuff.

config BR2_PACKAGE_OPENSSL_ENGINES
	bool "openssl additional engines"
	help
	  Install additional encryption engine libraries.

config BR2_PACKAGE_OPENSSL_PURIFY
	bool "disable OpenSSL memory hacks (for Valgrind)"
	default y if BR2_PACKAGE_VALGRIND
	default n
	help
	  This options disables some specific OpenSSL hacks that confuse Valgrind,
	  so it can report these hacks as invalid read/unitialized values/etc.

config BR2_PACKAGE_OPENSSL_WITHOUT_CNF
	bool "don't install default openssl.cnf, man, misc, etc. files"
	default y
	help
	  This option removes the default files for OpenSSL,
	  which are installed by default in /etc/ssl/.
endif
```

## package/rtw6_driver/Config.in
```kconfig
menuconfig BR2_PACKAGE_RTW6_DRIVER
	bool "Realtek WiFi6 Driver"
	default y

if BR2_PACKAGE_RTW6_DRIVER

config BR2_PACKAGE_RTW6_DRIVER_VERSION
	string "Git Branch"
	default "usdk_123"

config BR2_PACKAGE_RTW6_DRIVER_PROFILE
	string "Profile Name"

config BR2_PACKAGE_RTW6_CONFIG_PATH
	string "Path to config files on rootfs"
	default "/etc/rtw6_conf/"

config BR2_RTW6_DRIVER_8192
	bool
	default y
	depends on BR2_WIFI_2GHZ_RTW6_8192F
	help
	  Enabled if using rtl8192cd wifi driver

config BR2_RTW6_DRIVER_8852
	bool
	default y
	depends on BR2_WIFI_5GHZ_RTW6_8832A
	help
	  Enabled if using rtl8852 (g6) wifi driver
	
endif
```

## package/teal/Config.in
```kconfig
config BR2_PACKAGE_TEAL
	bool "Teal -> Lua transpiler and type checker"
	depends on BR2_PACKAGE_LUA
	depends on BR2_PACKAGE_LUAFILESYSTEM
	depends on BR2_PACKAGE_ARGPARSE
	help
	  Teal is a typed dialect of Lua.

	  https://github.com/teal-language/tl
```

## package/wpa_supplicant/Config.in
```kconfig
menuconfig BR2_PACKAGE_WPA_SUPPLICANT
	bool "wpa_supplicant"
	select BR2_PACKAGE_LIBNL
	select BR2_PACKAGE_OPENSSL
	help
	  WPA supplicant for secure wireless networks

	  http://w1.fi/wpa_supplicant/

if BR2_PACKAGE_WPA_SUPPLICANT

config BR2_PACKAGE_WPA_SUPPLICANT_REPOSITORY
	string "local git repository"

config BR2_PACKAGE_WPA_SUPPLICANT_VERSION
	string "git branch"

config BR2_PACKAGE_WPA_SUPPLICANT_DRIVER_NL80211
	bool "nl80211 drivers support"
	default y

config BR2_PACKAGE_WPA_SUPPLICANT_DRIVER_WEXT
	bool "Deprecated WEXT driver support"
	default n

config BR2_PACKAGE_WPA_SUPPLICANT_DRIVER_WIRED
	bool "Wired Ethernet drivers support"
	default n

config BR2_PACKAGE_WPA_SUPPLICANT_EAP
	bool "802.1X"
	default n

config BR2_PACKAGE_WPA_SUPPLICANT_WPS
	bool "Enable WPS"
	help
	  Enable support for Wi-Fi Protected Setup (WPS).

config BR2_PACKAGE_WPA_SUPPLICANT_WPA3
	bool "Enable WPA3 support"
	help
	  Enable WPA3 support

config BR2_PACKAGE_WPA_SUPPLICANT_DEBUG_SYSLOG
	bool "Enable syslog support"
	help
	  Enable support for sending debug messages to syslog.

config BR2_PACKAGE_WPA_SUPPLICANT_WPA_CLIENT_SO
	bool "Install wpa_client shared library"
	help
	  Install libwpa_client.so.

config BR2_PACKAGE_WPA_SUPPLICANT_PASSPHRASE
	bool "Install wpa_passphrase binary"
	help
	  Install wpa_passphrase command line utility.

endif
```

## package/zabbix/Config.in
```kconfig
config BR2_PACKAGE_ZABBIX
	bool "zabbix"
	select BR2_PACKAGE_PCRE
	select BR2_PACKAGE_LIBICONV
	help
	  Zabbix is an enterprise-class open source distributed
	  monitoring solution.Zabbix is free of cost. Zabbix
	  is written and distributed under the GPL General Public
	  License version 2.
```

## target/bcm/Config.in
```kconfig
choice
	prompt "Target Variant"
	default BRCM_CHIP_63178
config BRCM_CHIP_63178
	bool "63178"
	select arm
endchoice
```

## target/rlx/Config.in
```kconfig
choice
	prompt "Target Variant"

config RTL8685FB
	bool "RTL8685FB"
	select mips
	select RLX_86XX

config RTL8685PB
	bool "RTL8685PB"
	select mips
	select RLX_86XX

config RTL8196C
	bool "RTL8196C"
	select RLX_819X
	select mips

config RTL8196E
	bool "RTL8196E"
	select RLX_819X
	select mips

config RTL819xD
	bool "RTL819xD"
	select RLX_819X
	select mips

config RTL8198
	bool "RTL8198"
	select RLX_819X
	select mips

config RTL8881A
	bool "RTL8881A"
	select RLX_819X
	select mips

config RTL8198C
	bool "RTL8198C"
	select RLX_819X
	select mips

config RTL8197F
	bool "RTL8197F"
	select RLX_819X
	select mipsel

endchoice

config RLX_819X
	bool
	default n
	depends on !BR2_modems

config RLX_86XX
	bool
	default n
	depends on BR2_modems

config RTL8367
	bool "Gigabit Switch RTL8367"
	depends on RTL819xD || RTL8197F
	help
	  Enable support for gigabit ethernet switch RTL8367.

config RTL8211FS
	bool "Gigabit Transceiver RTL8211FS"
	depends on RTL819xD || RTL8197F
	help
	  Enable support for gigabit ethernet fiber transceiver RTL8211FS.

config RTL8211F
	bool "Gigabit Transceiver RTL8211F"
	depends on RTL819xD || RTL8197F
	help
	  Enable support for gigabit ethernet transceiver RTL8211F.

if !BR2_modems
	config BR2_WAN_PORT_NUM_0
	bool "Wan port number is 0"
	default n

	config BR2_WAN_PORT_NUM_3
	bool "Wan port number is 3"
	default n
endif

config BR2_TAR_IMAGE
	bool "Tar image"
	default n
	help
		Build image as tar archive without compression

config BR2_RLX_KERNEL_PADDING
	int "kernel padding"
	default 65536
	depends on RLX_819X
```

## target/rtk_luna/Config.in
```kconfig
choice
	prompt "Target Variant"

config RTL9607C
	bool "RTL9607C"
	select mips

config RTL8198D
	bool "RTL8198D"
	select mips

endchoice
```

## target/rtk_ms/Config.in
```kconfig
choice
	prompt "Target Variant"

config RTL9301
	bool "RTL-9301 (Demo board)"
	select mips

endchoice
```

## target/x86/Config.in
```kconfig
if i386
menu "QEMU specific"

# TODO: затем сделать отдельный таргет под qemu
config BR2_QEMU_MEMORY
	string "Qemu allocating"
	default "512M"

config BR2_QEMU_USE_STORAGE
	bool "Additional storage drive"
	default y
	help
	  This enables a persistent storage drive for virtual machine for
	  storing and loading config/factory settings.
endmenu
endif
```

## vendor/Config.in
```kconfig
menu "Vendor options"
source "vendor/dlink/Config.in"

if BR2_ralink
source "vendor/ralink/Config.in"
endif

if (BR2_rlx && !BR2_modems) || BR2_rtk_luna
source "vendor/realtek/Config.in"
endif

endmenu
```
